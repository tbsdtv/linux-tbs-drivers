## linux/drivers/media/dvb/smipcie/Kconfig
```kconfig
config DVB_SMIPCIE
	tristate "SMI PCIe DVBSky cards"
	depends on DVB_CORE && PCI && I2C
	select DVB_PLL if !DVB_FE_CUSTOMISE
	select DVB_M88DS3103 if !DVB_FE_CUSTOMISE
	select DVB_M88RS6000 if !DVB_FE_CUSTOMISE
	depends on RC_CORE
	---help---
	  Support for cards from DVBSky.

	  To compile this driver as a module, choose M here: the
	  module will be called smipcie
```
